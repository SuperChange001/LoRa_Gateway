
/****************************************Copyright (c)**************************************************
**                              四川唐门高新技术开发有限公司
**                                     研    发    部
**                                独门暗器之孔雀翎研究室
**
**                                http://www.蜀中唐门.com
**
**                                   维护健康 信守诚诺
**
**--------------文件信息--------------------------------------------------------------------------------
**文   件   名: nongli.h
**创   建   人: 赖皮
**最后修改日期: 2011年10月
**描        述: 最强万年历
**              支持所有的单片机、ARM、AVR、MSP430、PIC等(支持C开发)
**              可嵌入任何标准C编译器  BC++、VC、ADS、KEIL等
**用        法: 在ADS,Keil,BC++上可仿真
**
#include "nongli.h"
void main(void)
{
    unsigned char week;
    unsigned char NLyear[4];
    unsigned char JQdate;
             char str[15];

    while(1)
    {
        GetChinaCalendar   (2007,2,8,NLyear);  //NLyear={20,06,12,21}
        GetChinaCalendarStr(2007,2,8,str);     //str   ={"丙戌年腊月廿一"}
        GetWeek            (2007,2,8,&week);   //week  =4
        GetJieQi           (2007,2,8,&JQdate); //JQdate=4 意思为本月的4号是个节气
        GetJieQiStr        (2007,2,4,str);     //str   ={"立春"}
        GetJieQiStr        (2007,2,8,str);     //str   ={"离雨水还有11天"}
        GetShengXiaoStr    (2007,3,4,str);     //str   ={"猪"}
   }
}
**
**          LAI2005PI@126.com
********************************************************************************************************
**--------------历史版本信息----------------------------------------------------------------------------
** 创建人: 赖皮
** 版  本: v1.0
** 日　期: 2007年02月6日
** 描　述:
**          这是改写网友Campo的万年历C51。
**          原作使用了数组查表法，效率较高。
**          移植到ARM上，我改写了进入参数。返回采用指针传递
**          增加了天干地支转换              ★〓个人原创〓★
**          输入公历日期得到农历字符串
**          非本人原创部分仅供研究与学习之用。如想商业使用，
**          请与原作者Campo联系——虽然我也不知道他的联系方式 ^o^
**
**★〓 仅以此献给我的宝贝女儿小涵，我的小狗狗要过第一个春节了 〓★
**★〓    任何人都可以发布和使用，希望保留本文件信息。谢谢    〓★
**
**------------------------------------------------------------------------------------------------------
********************************************************************************************************
**--------------历史版本信息----------------------------------------------------------------------------
** 创建人: 赖皮
** 版  本: v2.0(情人节版)   我会在2月14日发布-->愿天下有情人终成眷属
**                                              愿和我一样已经进城的人幸福美满
** 日　期: 2007年02月8日
** 描　述:
**          应网友的要求增加24节气的支持    ★〓个人原创〓★
**          为了节约空间我未采用复杂算法  而先把节气标志做了个表格(好累人哦)
**          一年的24个节气的日期只需要3个字节编码,每个bit对应一个节气 高->低
**          50年的节气表,只需要150个字节的存储空间
**          如果本月的节气日期等于基本日期 bit=0  else  bit=1
**
**★〓   仅以此献给我亲爱的刘筒, 我一定会给你种柚子和樱桃的   〓★
**★〓    任何人都可以发布和使用，希望保留本文件信息。谢谢    〓★
**
**------------------------------------------------------------------------------------------------------
********************************************************************************************************
**--------------历史版本信息----------------------------------------------------------------------------
** 创建人: 赖皮
** 版  本: v3.0(元宵节版)   今天是元宵节
**
** 日　期: 2007年03月04日
** 描　述:
**          增加12生肖                       ★〓个人原创〓★
**          12生肖比较简单,只要知道12地支就可以了
**          子-->鼠,丑-->牛,寅-->虎 ...
**          鼠不分大小都喊老 （谁能对上)
**          增加移植选项,因为不同的平台要把常量表格定义到ROM段需要不同的关键字
**          目前只给出ARM、C51两种,用户可自己扩展
**
**★〓   仅以此献给我亲爱的妈老汉儿, 我一定会挣大钱的(未来)   〓★
**★〓    任何人都可以发布和使用，希望保留本文件信息。谢谢    〓★
**
**------------------------------------------------------------------------------------------------------********************************************************************************************************
**--------------历史版本信息----------------------------------------------------------------------------
** 创建人: 赖皮
** 版  本: v3.1(2012版)   迎接2012
**
** 日　期: 2011年10月
** 描　述:
**         修正一些小bug
**
**★〓   仅以此献给我亲爱的妈妈, 希望你手术成功(肯定)         〓★
**★〓    任何人都可以发布和使用，希望保留本文件信息。谢谢    〓★
**
**------------------------------------------------------------------------------------------------------
********************************************************************************************************
**--------------当前版本修订------------------------------------------------------------------------------
** 修改人:
** 版  本:
** 日　期:
** 描　述:
**
**------------------------------------------------------------------------------------------------------
********************************************************************************************************/

/****************************************************************************
* 移植到不同平台需要改动的地方
* 可根据需要添加PIC、AVR等定义关键字
****************************************************************************/
#include "nongli.h"
#define     C51         0
#define     ARM         1

#define     CPU_TYPE    ARM    // 用户根据不同平台指定 如果是51该处应改为 C51       

#if CPU_TYPE ==  C51
#define KeyWord	code   // 在C51下code 代码放到ROM段
#else
#define KeyWord	const  // 在ARM下const代码放到ROM段
#endif

/* 剪裁相关不用的代码 */
#define JieQiEn             1  // 1:使能节气相关代码
#define ShengXiaoEn         1  // 1:使能生肖相关代码

static unsigned char KeyWord year_code[]= {
    0x04,0xAe,0x53, //1901 0
    0x0A,0x57,0x48, //1902 3
    0x55,0x26,0xBd, //1903 6
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    0x2d,0x92,0xB5, //2099
};

/*月份数据表*/
static unsigned char  KeyWord day_code1[9]= {0x0,0x1f,0x3b,0x5a,0x78,0x97,0xb5,0xd4,0xf3};
static unsigned short KeyWord day_code2[3]= {0x111,0x130,0x14e};
/****************************************************************************
* 子函数,用于读取数据表中农历月的大月或小月,如果该月为大返回1,为小返回0
****************************************************************************/
static unsigned char GetMoonDay(unsigned char month_p,unsigned short table_addr)
{
    switch (month_p)
    {
    case 1:
        if((year_code[table_addr]&0x08)==0)	return(0);
        else 								return(1);
    case 2:
        if((year_code[table_addr]&0x04)==0)	return(0);
        else 								return(1);
    case 3:
        if((year_code[table_addr]&0x02)==0)	return(0);
        else 								return(1);
    case 4:
        if((year_code[table_addr]&0x01)==0)	return(0);
        else 								return(1);
    case 5:
        if((year_code[table_addr+1]&0x80)==0)	return(0);
        else 									return(1);
    case 6:
        if((year_code[table_addr+1]&0x40)==0)	return(0);
        else 									return(1);
    case 7:
        if((year_code[table_addr+1]&0x20)==0)	return(0);
        else 									return(1);
    case 8:
        if((year_code[table_addr+1]&0x10)==0)	return(0);
        else 									return(1);
    case 9:
        if((year_code[table_addr+1]&0x08)==0)	return(0);
        else 									return(1);
    case 10:
        if((year_code[table_addr+1]&0x04)==0)	return(0);
        else 									return(1);
    case 11:
        if((year_code[table_addr+1]&0x02)==0)	return(0);
        else 									return(1);
    case 12:
        if((year_code[table_addr+1]&0x01)==0)	return(0);
        else 									return(1);
    case 13:
        if((year_code[table_addr+2]&0x80)==0)	return(0);
        else 									return(1);
    }
    return(0);
}

/*********************************************************************************************************
** 函数名称:GetChinaCalendar
** 功能描述:公农历转换(只允许1901-2099年)
** 输　入:  year        公历年
**          month       公历月
**          day         公历日
**          p           储存农历日期地址
** 输　出:  1           成功
**          0           失败
** 作　者:  Campo
** 修  改:  赖皮
** 日　期:  2007年02月06日
**-------------------------------------------------------------------------------------------------------
** 修改人:
** 日　期:
**------------------------------------------------------------------------------------------------------
********************************************************************************************************/
unsigned char GetChinaCalendar(
    unsigned int  year,
    unsigned char month,
    unsigned char day,
    unsigned char *p)
{
    unsigned char temp1,temp2,temp3,month_p,yearH,yearL;
    unsigned char flag_y;
    unsigned short temp4,table_addr;

    yearH=year/100;
    yearL=year%100;
    if((yearH!=19)&&(yearH!=20))	return(0);

    /* 定位数据表地址 */
    table_addr=(int)(yearL-1)*3;
    if(yearH==20)	table_addr+=100*3;

    /* 取当年春节所在的公历月份 */
    temp1=year_code[table_addr+2]&0x60;
    temp1>>=5;

    /* 取当年春节所在的公历日 */
    temp2=year_code[table_addr+2]&31;

    /* 计算当年春年离当年元旦的天数,春节只会在公历1月或2月 */
    if(temp1==1) 	temp3=temp2-1;
    else 			temp3=temp2+31-1;

    /* 计算公历日离当年元旦的天数 */
    if (month<10) 	temp4=day_code1[month-1]+day-1;
    else  			temp4=day_code2[month-10]+day-1;
    /* 如果公历月大于2月并且该年的2月为闰月,天数加1 */
    if ((month>2)&&(yearL%4==0)) 	temp4++;

    /* 判断公历日在春节前还是春节后 */
    if (temp4>=temp3)
    {
        temp4-=temp3;
        month=1;
        month_p=1;

        flag_y=0;
        if(GetMoonDay(month_p,table_addr)==0)	temp1=29; //小月29天
        else 									temp1=30; //大小30天
        /* 从数据表中取该年的闰月月份,如为0则该年无闰月 */
        temp2=year_code[table_addr]/16;
        while(temp4>=temp1)
        {
            temp4-=temp1;
            month_p++;
            if(month==temp2)
            {
                flag_y=~flag_y;
                if(flag_y==0)month++;
            }
            else month++;
            if(GetMoonDay(month_p,table_addr)==0)	temp1=29;
            else 									temp1=30;
        }
        day=temp4+1;
    }
    /* 公历日在春节前使用下面代码进行运算 */
    else
    {
        temp3-=temp4;
        if (yearL==0)
        {
            yearL=100-1;
            yearH=19;
        }
        else yearL--;
        table_addr-=3;
        month=12;
        temp2=year_code[table_addr]/16;
        if (temp2==0)	month_p=12;
        else 			month_p=13;

        flag_y=0;
        if(GetMoonDay(month_p,table_addr)==0)	temp1=29;
        else 									temp1=30;
        while(temp3>temp1)
        {
            temp3-=temp1;
            month_p--;
            if(flag_y==0)		month--;
            if(month==temp2)	flag_y=~flag_y;
            if(GetMoonDay(month_p,table_addr)==0)	temp1=29;
            else 									temp1=30;
        }
        day=temp1-temp3+1;
    }

    *p++=yearH;
    *p++=yearL;
    *p++=month;
    *p=day;
    return(1);
}

static unsigned char KeyWord table_week[12]= {0,3,3,6,1,4,6,2,5,0,3,5}; //月修正数据表
/*********************************************************************************************************
** 函数名称:GetWeek
** 功能描述:输入公历日期得到星期(只允许1901-2099年)
** 输　入:  year        公历年
**          month       公历月
**          day	        公历日
**          week        储存星期地址
** 输　出:  无
** 作　者:  Campo
** 修  改:  赖皮
** 日　期:  2007年02月06日
**-------------------------------------------------------------------------------------------------------
** 修改人:
** 日　期:
**------------------------------------------------------------------------------------------------------
********************************************************************************************************/
void GetWeek(
    unsigned int year,
    unsigned char month,
    unsigned char day,
    unsigned char *week)
{
    unsigned int temp2;
    unsigned char yearH,yearL;

    yearH=year/100;
    yearL=year%100;

    /* 如果为21世纪,年份数加100 */
    if (yearH>19)	 	yearL+=100;
    /* 所过闰年数只算1900年之后的 */
    temp2=yearL+yearL/4;
    temp2=temp2%7;
    temp2=temp2+day+table_week[month-1];
    if (yearL%4==0&&month<3)	temp2--;
    *week=(temp2%7);
}

/*********************************************************************************************************
** 函数名称:GetSkyEarth
** 功能描述:输入公历日期得到一个甲子年(只允许1901-2099年)
** 输　入:  year        公历年
**          p           储存一个甲子年地址
** 输　出:  无
** 作　者:  赖皮        ★〓个人原创〓★
** 日　期:  2007年02月06日
**-------------------------------------------------------------------------------------------------------
** 修改人:
** 日　期:
**------------------------------------------------------------------------------------------------------
********************************************************************************************************/
static void GetSkyEarth(unsigned int year,unsigned char *p)
{
    unsigned char x;

    if(year>=1984)
    {
        year=year-1984;
        x=year%60;
    }
    else
    {
        year=1984-year;
        x=60-year%60;
    }
    *p=x;
}
static unsigned char KeyWord sky[][3]=  {"甲","乙","丙","丁","戊","己","庚","辛","壬","癸",};
static unsigned char KeyWord earth[][3]= {"子","丑","寅","卯","辰","巳","午","未","申","酉","戌","亥",};
static unsigned char KeyWord monthcode[][3]= {"一","二","三","四","五","六","七","八","九","十","冬","腊",};
static unsigned char KeyWord nongliday[][3]= {"初","十","廿","三",};
static void StrCopy(char *target,unsigned char const *source,unsigned char no)
{
#if CPU_TYPE == C51
    unsigned char i;
#else
    unsigned int i;
#endif

    for(i=0; i<no; i++)
    {
        *target++=*source++;
    }
}
/*********************************************************************************************************
** 函数名称:GetChinaCalendarStr
** 功能描述:输入公历日期得到农历字符串
**          如:GetChinaCalendarStr(2007,02,06,str) 返回str="丙戌年腊月十九"
** 输　入:  year        公历年
**          month       公历月
**          day         公历日
**          str         储存农历日期字符串地址   15Byte
** 输　出:  无
** 作　者:  赖皮        ★〓个人原创〓★
** 日　期:  2007年02月06日
**-------------------------------------------------------------------------------------------------------
** 修改人:
** 日　期:
**------------------------------------------------------------------------------------------------------
********************************************************************************************************/
void GetChinaCalendarStr(
    unsigned int  year,
    unsigned char month,
    unsigned char day,
    char *str)
{
    unsigned char NLyear[4];
    unsigned char SEyear;

    StrCopy(&str[0],(unsigned char *)"甲子年正月初一",15);
    if(GetChinaCalendar(year,month,day,(unsigned char *)NLyear)==0)	return;
    GetSkyEarth(NLyear[0]*100+NLyear[1],&SEyear);
    StrCopy(&str[0],(unsigned char *)  sky[SEyear%10],2);	//  甲
    StrCopy(&str[2],(unsigned char *)earth[SEyear%12],2);	//  子

    if(NLyear[2]==1)	StrCopy(&str[6],(unsigned char *)"正",2);
    else				StrCopy(&str[6],(unsigned char *)monthcode[NLyear[2]-1],2);

    if(NLyear[3]>10) 	StrCopy(&str[10],(unsigned char *)nongliday[NLyear[3]/10],2);
    else				StrCopy(&str[10],(unsigned char *)"初",2);
    StrCopy(&str[12],(unsigned char *)monthcode[(NLyear[3]-1)%10],2);
}

/*********************************************************************************************************
**         以下为24节气计算相关程序
**------------------------------------------------------------------------------------------------------
********************************************************************************************************/

#if  JieQiEn == 1
/*
    每年24节气标志表
    有兴趣的朋友可按照上面给的原理添加其它年份的表格
    不是很清楚的朋友可给我发EMAIL
*/
static unsigned char KeyWord YearMonthBit[]=
{
    0x4E,0xA6,0x99,		//2000
    0x9C,0xA2,0x98,		//2001
    0x80,0x00,0x18,		//2002
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    0xBE,0xA6,0x18,		//2050
};
static unsigned char KeyWord days[]=
{
    6,20,4,19,6,21,         //一月到三月  的节气基本日期
    5,20,6,21,6,21,         //四月到六月  的节气基本日期
    7,23,8,23,8,23,         //七月到九月  的节气基本日期
    8,24,8,22,7,22,         //十月到十二月的节气基本日期
};
static char KeyWord JieQiStr[][5]=  //以公历日期先后排序
{
    /*  名称        角度    公历日期     周期 */
    "小寒",     //285     1月 6日
    "大寒",     //300     1月20日    29.5天
    "立春",     //315     2月 4日
    "雨水",     //330     2月19日    29.8天
    "惊蛰",     //345     3月 6日
    "春分",     //  0     3月21日    30.2天
    "清明",     // 15     4月 5日
    "谷雨",     // 30     4月20日    30.7天
    "立夏",     // 45     5月 6日
    "夏满",     // 60     5月21日    31.2天
    "芒种",     // 75     6月 6日
    "夏至",     // 90     6月21日    31.4天
    "小暑",     //105     7月 7日
    "大暑",     //120     7月23日    31.4天
    "立秋",     //135     8月 8日
    "处暑",     //150     8月23日    31.1天
    "白露",     //165     9月 8日
    "秋分",     //180     9月23日    30.7天
    "寒露",     //195    10月 8日
    "霜降",     //210    10月24日    30.1天
    "立冬",     //225    11月 8日
    "小雪",     //240    11月22日    29.7天
    "大雪",     //255    12月 7日
    "冬至",     //270    12月22日    29.5天
};
/*********************************************************************************************************
** 函数名称:GetJieQi
** 功能描述:输入公历日期得到本月24节气日期 day<15返回上半月节气,反之返回下半月
**          如:GetJieQiStr(2007,02,08,str) 返回str[0]=4
** 输　入:  year        公历年
**          month       公历月
**          day         公历日
**          str         储存对应本月节气日期地址   1Byte
** 输　出:  1           成功
**          0           失败
** 作　者:  赖皮        ★〓个人原创〓★
** 日　期:  2007年02月08日
**-------------------------------------------------------------------------------------------------------
** 修改人:
** 日　期:
**------------------------------------------------------------------------------------------------------
********************************************************************************************************/
unsigned char GetJieQi(
    unsigned  int year,
    unsigned char month,
    unsigned char day,
    unsigned char *JQdate)
{
    unsigned char bak1,value,JQ;

    if((year<2000)||(year>2050))     return 0;
    if((month==0) ||(month>12))      return 0;
    JQ = (month-1) *2 ;		                        //获得节气顺序标号(0～23
    if(day >= 15) JQ++; 	                        //判断是否是上半月

    bak1=YearMonthBit[(year-2000)*3+JQ/8];          //获得节气日期相对值所在字节
    value =((bak1<<(JQ%8))&0x80);                   //获得节气日期相对值状态

    *JQdate=days[JQ];
    if( value != 0 )
    {
        //判断年份,以决定节气相对值1代表1,还是－1。
        if( (JQ== 1||JQ== 11||JQ== 18||JQ== 21)&&year< 2044)  (*JQdate)++;
        else                                                  (*JQdate)--;
    }
    return 1;
}
static unsigned char KeyWord MonthDayMax[]= {31,28,31,30,31,30,31,31,30,31,30,31,};
/*********************************************************************************************************
** 函数名称:GetJieQiStr
** 功能描述:输入公历日期得到24节气字符串
**          如:GetJieQiStr(2007,02,08,str) 返回str="离雨水还有11天"
** 输　入:  year        公历年
**          month       公历月
**          day         公历日
**          str         储存24节气字符串地址   15Byte
** 输　出:  1           成功
**          0           失败
** 作　者:  赖皮        ★〓个人原创〓★
** 日　期:  2007年02月08日
**-------------------------------------------------------------------------------------------------------
** 修改人: YMW 今天是节气  返回 Str = "今天雨水"; 不是返回Str = "离雨水11";
** 日　期:
**------------------------------------------------------------------------------------------------------
********************************************************************************************************/
unsigned char GetJieQiStr(
    unsigned int year,
    unsigned char month,
    unsigned char day,
    char *str)
{
    unsigned char JQdate,JQ,MaxDay;

    if(GetJieQi(year,month,day,&JQdate)==0)	return 0;

    JQ = (month-1) *2 ;                             //获得节气顺序标号(0～23
    if(day >= 15) JQ++;                             //判断是否是上半月

    if(day==JQdate)                                 //今天正是一个节气日
    {
        StrCopy(str,(unsigned char *)"今天小寒",9);
        StrCopy(&str[4],(unsigned char *)JieQiStr[JQ],4);
        return 1;
    }
    //今天不是一个节气日
    StrCopy(str,(unsigned char *)"离小寒??",9);
    if(day<JQdate)                                  //如果今天日期小于本月的节气日期
    {
        StrCopy(&str[2],(unsigned char *)JieQiStr[JQ],4);
        day=JQdate-day;
    }
    else                                            //如果今天日期大于本月的节气日期
    {
        StrCopy(&str[2],(unsigned char *)JieQiStr[(JQ+1)%24],4);
        //每年只有24个节气 此处需限定 冬至翻转会溢出
        if(day < 15)
        {
            GetJieQi(year,month,15,&JQdate);
            day=JQdate-day;
        }
        else                                        //翻月
        {
            MaxDay=MonthDayMax[month-1];
            if(month==2)                            //润月问题
            {
                if((year%4==0)&&((year%100!=0)||(year%400==0))) MaxDay++;
            }
            if(++month==13)	month=1;
            GetJieQi(year,month,1,&JQdate);
            day=MaxDay-day+JQdate;
        }
    }
    str[6]=day/10+'0';
    str[7]=day%10+'0';
    return 1;
}
#endif
/*********************************************************************************************************
**         以下为12生肖计算相关程序
**------------------------------------------------------------------------------------------------------
********************************************************************************************************/
#if  ShengXiaoEn == 1
static char KeyWord ShengXiao[][3]=
{
    "鼠","牛","虎","兔","龙","蛇",
    "马","羊","猴","鸡","狗","猪",
};
/*********************************************************************************************************
** 函数名称:GetShengXiaoStr
** 功能描述:输入公历日期得到12生肖字符串
**          如:GetShengXiaoStr    (2007,3,4,str);     //str   ={"猪"}
** 输　入:  year        公历年
**          month       公历月
**          day         公历日
**          str         储存12生肖字符串地址   3Byte
** 输　出:  无
** 作　者:  赖皮        ★〓个人原创〓★
** 日　期:  2007年03月04日
**-------------------------------------------------------------------------------------------------------
** 修改人:
** 日　期:
**------------------------------------------------------------------------------------------------------
********************************************************************************************************/
void GetShengXiaoStr(
    unsigned int  year,
    unsigned char month,
    unsigned char day,
    char *str)
{
    unsigned char NLyear[4];
    unsigned char SEyear;

    if(GetChinaCalendar(year,month,day,(unsigned char *)NLyear)==0)	return;
    GetSkyEarth(NLyear[0]*100+NLyear[1],&SEyear);
    StrCopy(str,(unsigned char *)ShengXiao[SEyear%12],3);
}
#endif

